## meta-inventec/conf/layer.conf
```bitbake
# We have a conf and classes directory, add to BBPATH
BBPATH .= ":${LAYERDIR}"

# We have recipes-* directories, add to BBFILES
BBFILES += "${LAYERDIR}/meta-common/recipes-*/*/*.bb \
            ${LAYERDIR}/meta-common/recipes-*/*/*/*.bb \
            ${LAYERDIR}/meta-common/recipes-*/*/*.bbappend"

BBFILE_COLLECTIONS += "inventec-layer"
BBFILE_PATTERN_inventec-layer := "^${LAYERDIR}/"

LAYERVERSION_inventec-layer = "1"
LAYERSERIES_COMPAT_inventec-layer = "warrior zeus dunfell gatesgarth"

# Provide a variable that points the base of the inventec layer.
INVENTECBASE = '${@os.path.normpath("${LAYERDIR}/")}'
```

## meta-inventec/meta-c600g5/conf/layer.conf
```bitbake
# We have a conf and classes directory, add to BBPATH
BBPATH .= ":${LAYERDIR}"

# We have recipes-* directories, add to BBFILES
BBFILES += "${LAYERDIR}/recipes-*/*/*.bb \
            ${LAYERDIR}/recipes-*/*/*.bbappend"

BBFILE_COLLECTIONS += "c600g5"
BBFILE_PATTERN_c600g5 := "^${LAYERDIR}/"
# BBFILE_PRIORITY_c600g5 = "5"

#Yocto Project
#Release	Codename	Date
#3.2		Gatesgarth	10/2020
#3.1		Dunfell		04/2020
#3.0		Zeus		10/2019
#2.7		Warrior		04/2019
#2.6		Thud		11/2018
LAYERSERIES_COMPAT_c600g5 = "warrior zeus dunfell gatesgarth"
```

## meta-inventec/meta-c600g5/conf/machine/c600g5.conf
```bitbake
KMACHINE = "aspeed"
KERNEL_DEVICETREE = "${KMACHINE}-bmc-inventec-${MACHINE}.dtb"

require conf/machine/include/ast2500.inc
require conf/machine/include/obmc-bsp-common.inc
require conf/machine/include/inventec.inc

UBOOT_MACHINE = "ast_g5_phy_config"

#for 32M image
#FLASH_SIZE = "32768"
#FLASH_RWFS_OFFSET = "28672"

#for 64M image
FLASH_SIZE = "65536"
FLASH_RWFS_OFFSET = "49152"

#for local build 
#SOURCE_MIRROR_URL ?= "file://source_mirror/sources/"
#INHERIT += "own-mirrors"
#BB_GENERATE_MIRROR_TARBALLS = "1"
#BB_NO_NETWORK = "1"

VIRTUAL-RUNTIME_skeleton_workbook = "${MACHINE}-config"

PREFERRED_PROVIDER_virtual/phosphor-led-manager-config-native ?= "c600g5-led-manager-config-native"
#PREFERRED_PROVIDER_virtual/obmc-host-ctl ?= "obmc-op-control-host"
PREFERRED_PROVIDER_virtual/obmc-host-ctl = "packagegroup-inventec-apps"
PREFERRED_PROVIDER_virtual/obmc-host-ipmi-hw = "phosphor-ipmi-kcs"
PREFERRED_PROVIDER_virtual/obmc-gpio-monitor = "phosphor-gpio-monitor"
PREFERRED_PROVIDER_virtual/phosphor-ipmi-sensor-inventory = "c600g5-ipmi-sensor-map-native"
```

## meta-wiwynn/meta-sv310g4/conf/layer.conf
```bitbake
# We have a conf and classes directory, add to BBPATH
BBPATH .= ":${LAYERDIR}"

# We have recipes-* directories, add to BBFILES
BBFILES += "${LAYERDIR}/recipes-*/*/*.bb \
            ${LAYERDIR}/recipes-*/*/*.bbappend"

BBFILE_COLLECTIONS += "sv310g4"
BBFILE_PATTERN_sv310g4 := "^${LAYERDIR}/"
# BBFILE_PRIORITY_sv300g3e = "5"
LAYERSERIES_COMPAT_sv310g4 = "gatesgarth warrior zeus"
```
